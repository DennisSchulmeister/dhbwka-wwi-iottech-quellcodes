## 08 Linux/custom/Config.in
```kconfig
#source "$BR2_EXTERNAL_DHBW_PATH/package/jdk/Config.in"

# dlib
source "$BR2_EXTERNAL_DHBW_PATH/package/libdlib/Config.in"
source "$BR2_EXTERNAL_DHBW_PATH/package/python-dlib/Config.in"

# Andere Python-Pakete
source "$BR2_EXTERNAL_DHBW_PATH/package/python-face_recognition/Config.in"
source "$BR2_EXTERNAL_DHBW_PATH/package/python-face_recognition_models/Config.in"
source "$BR2_EXTERNAL_DHBW_PATH/package/python-picamera/Config.in"
source "$BR2_EXTERNAL_DHBW_PATH/package/python-imutils/Config.in"
```

## 08 Linux/custom/configs/dhbw_wayland_defconfig
```kconfig
###BR2_aarch64=y
###BR2_cortex_a53=y
###BR2_ARM_FPU_VFPV4=y
BR2_arm=y
BR2_cortex_a53=y
BR2_ARM_FPU_NEON_VFPV4=y

BR2_DL_DIR="../download"
BR2_CCACHE=y
BR2_CCACHE_DIR="$(HOME)/cache"
BR2_PACKAGE_OVERRIDE_FILE="$(BR2_EXTERNAL_DHBW_PATH)/local.mk"

BR2_TOOLCHAIN_BUILDROOT_WCHAR=y
BR2_TOOLCHAIN_BUILDROOT_GLIBC=y
BR2_TOOLCHAIN_BUILDROOT_CXX=y
BR2_GCC_ENABLE_LTO=y

BR2_TARGET_GENERIC_HOSTNAME="embedded"
BR2_TARGET_GENERIC_ISSUE="Welcome to your embedded system"
# BR2_TARGET_ENABLE_ROOT_LOGIN is not set
BR2_ENABLE_LOCALE_WHITELIST="C en_US en_DK"

BR2_ROOTFS_MERGED_USR=y
BR2_ROOTFS_DEVICE_CREATION_DYNAMIC_EUDEV=y
BR2_ROOTFS_USERS_TABLES="$(BR2_EXTERNAL_DHBW_PATH)/users"
BR2_ROOTFS_OVERLAY="$(BR2_EXTERNAL_DHBW_PATH)/board/rootfs_overlay"
###BR2_ROOTFS_POST_BUILD_SCRIPT="$(BR2_EXTERNAL_DHBW_PATH)/cmdline.sh $(BR2_EXTERNAL_DHBW_PATH)/config.sh board/raspberrypi3-64/post-build.sh"
###BR2_ROOTFS_POST_IMAGE_SCRIPT="board/raspberrypi3-64/post-image.sh"
###BR2_ROOTFS_POST_SCRIPT_ARGS="--aarch64 --add-pi3-miniuart-bt-overlay"
BR2_ROOTFS_POST_BUILD_SCRIPT="$(BR2_EXTERNAL_DHBW_PATH)/cmdline.sh $(BR2_EXTERNAL_DHBW_PATH)/config.sh board/raspberrypi3/post-build.sh"
BR2_ROOTFS_POST_IMAGE_SCRIPT="board/raspberrypi3/post-image.sh"
BR2_ROOTFS_POST_SCRIPT_ARGS="--add-pi3-miniuart-bt-overlay"
BR2_ROOTFS_DEVICE_TABLE="$(BR2_EXTERNAL_DHBW_PATH)/permissions"
BR2_ROOTFS_DEVICE_TABLE_SUPPORTS_EXTENDED_ATTRIBUTES=y

BR2_LINUX_KERNEL=y
BR2_LINUX_KERNEL_CUSTOM_GIT=y
BR2_LINUX_KERNEL_CUSTOM_REPO_URL="https://github.com/raspberrypi/linux.git"
BR2_LINUX_KERNEL_CUSTOM_REPO_VERSION="5d63a4595d32a8505590d5fea5c4ec1ca79fd49d"
BR2_LINUX_KERNEL_DEFCONFIG="bcm2709"
BR2_LINUX_KERNEL_DTS_SUPPORT=y
###BR2_LINUX_KERNEL_INTREE_DTS_NAME="broadcom/bcm2710-rpi-3-b broadcom/bcm2710-rpi-3-b-plus broadcom/bcm2837-rpi-3-b"
BR2_LINUX_KERNEL_INTREE_DTS_NAME="bcm2710-rpi-3-b bcm2710-rpi-3-b-plus bcm2710-rpi-cm3"
BR2_PACKAGE_HOST_LINUX_HEADERS_CUSTOM_4_14=y

BR2_PACKAGE_BUSYBOX_CONFIG="$(BR2_EXTERNAL_DHBW_PATH)/busybox.config"
BR2_PACKAGE_GETTEXT=y
BR2_PACKAGE_MESA3D=y
BR2_PACKAGE_MESA3D_GALLIUM_DRIVER_VC4=y
BR2_PACKAGE_MESA3D_OPENGL_EGL=y
BR2_PACKAGE_MESA3D_OPENGL_ES=y
BR2_PACKAGE_WESTON=y
BR2_PACKAGE_WESTON_DRM=y
BR2_PACKAGE_XORG7=y
BR2_PACKAGE_RPI_BT_FIRMWARE=y
BR2_PACKAGE_RPI_FIRMWARE=y
BR2_PACKAGE_RPI_WIFI_FIRMWARE=y
BR2_PACKAGE_KBD=y
BR2_PACKAGE_LINUX_PAM=y
BR2_PACKAGE_IPUTILS=y
BR2_PACKAGE_OPENSSH=y
BR2_PACKAGE_WIRELESS_REGDB=y
BR2_PACKAGE_WIRELESS_TOOLS=y
BR2_PACKAGE_WPA_SUPPLICANT=y
BR2_PACKAGE_WPA_SUPPLICANT_AP_SUPPORT=y
BR2_PACKAGE_WPA_SUPPLICANT_WIFI_DISPLAY=y
BR2_PACKAGE_WPA_SUPPLICANT_MESH_NETWORKING=y
BR2_PACKAGE_WPA_SUPPLICANT_AUTOSCAN=y
BR2_PACKAGE_WPA_SUPPLICANT_EAP=y
BR2_PACKAGE_WPA_SUPPLICANT_HOTSPOT=y
BR2_PACKAGE_WPA_SUPPLICANT_DEBUG_SYSLOG=y
BR2_PACKAGE_WPA_SUPPLICANT_WPS=y
BR2_PACKAGE_WPA_SUPPLICANT_CLI=y
BR2_PACKAGE_WPA_SUPPLICANT_WPA_CLIENT_SO=y
BR2_PACKAGE_WPA_SUPPLICANT_PASSPHRASE=y
BR2_PACKAGE_SUDO=y

BR2_TARGET_ROOTFS_EXT2=y
BR2_TARGET_ROOTFS_EXT2_4=y
BR2_TARGET_ROOTFS_EXT2_LABEL="root"
BR2_TARGET_ROOTFS_EXT2_SIZE="300M"
# BR2_TARGET_ROOTFS_TAR is not set

BR2_PACKAGE_HOST_DOSFSTOOLS=y
BR2_PACKAGE_HOST_GENIMAGE=y
BR2_PACKAGE_HOST_MTOOLS=y
```

## 08 Linux/custom/package/libdlib/Config.in
```kconfig
config BR2_PACKAGE_LIBDLIB
	bool "libdlib"
	select BR2_PACKAGE_GIFLIB
	select BR2_PACKAGE_LIBJPEG
	select BR2_PACKAGE_LIBPNG
	select BR2_PACKAGE_SQLITE
	help
	  Dlib is a modern C++ toolkit containing machine learning
	  algorithms and tools for creating complex software in C++
	  to solve real world problems. It is used in both industry
	  and academia in a wide range of domains including robotics,
	  embedded devices, mobile phones, and large high performance
	  computing environments. Dlib's open source licensing allows
	  you to use it in any application, free of charge.

	  NOTE: This is the C++ version of dlib, which builds a library,
	  against which applications can link. As per upstream this
	  is not needed for the python-bindings, which link against
	  a static copy of the library.

	  http://dlib.net/

if BR2_PACKAGE_LIBDLIB

config BR2_PACKAGE_LIBDLIB_GUI_SUPPORT
	bool "gui support"
	depends on BR2_PACKAGE_XLIB_LIBX11
	help
	  gui widgets for libdlib

comment "gui support needs libX11"
	depends on !BR2_PACKAGE_XLIB_LIBX11

endif
```

## 08 Linux/custom/package/python-dlib/Config.in
```kconfig
config BR2_PACKAGE_PYTHON_DLIB
	bool "python-dlib"
	select BR2_PACKAGE_GIFLIB
	select BR2_PACKAGE_LIBJPEG
	select BR2_PACKAGE_LIBPNG
	select BR2_PACKAGE_SQLITE
	depends on BR2_PACKAGE_PYTHON3
	help
	  Dlib is a modern C++ toolkit containing machine learning
	  algorithms and tools for creating complex software in C++
	  to solve real world problems. It is used in both industry
	  and academia in a wide range of domains including robotics,
	  embedded devices, mobile phones, and large high performance
	  computing environments. Dlib's open source licensing allows
	  you to use it in any application, free of charge.
	  
	  NOTE: This is the python version of dlib, which statically
	  links against libdlib, as per upstream. If you also need
	  the C++ library itself you need to enable libdlib, too.

	  http://dlib.net/

comment "python-dlib requires python3"
	depends on !BR2_PACKAGE_PYTHON3

if BR2_PACKAGE_PYTHON_DLIB

config BR2_PACKAGE_PYTHON_DLIB_GUI_SUPPORT
	bool "gui support"
	depends on BR2_PACKAGE_XLIB_LIBX11
	help
	  gui widgets for libdlib

comment "gui support needs libX11"
	depends on !BR2_PACKAGE_XLIB_LIBX11

endif
```

## 08 Linux/custom/package/python-face_recognition_models/Config.in
```kconfig
config BR2_PACKAGE_PYTHON_FACE_RECOGNITION_MODELS
	bool "python-face_recognition_models"
	help
	  Models used by the face_recognition package.

	  https://github.com/ageitgey/face_recognition_models
```
